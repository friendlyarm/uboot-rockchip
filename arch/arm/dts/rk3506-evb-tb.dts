/*
 * SPDX-License-Identifier:     GPL-2.0+
 *
 * (C) Copyright 2024 Rockchip Electronics Co., Ltd
 */

/dts-v1/;
#include "rk3506-evb.dts"

&chosen {
	u-boot,spl-boot-order = &spi_nand, &spi_nor, &mmc;
};
