/*
 * SPDX-License-Identifier:     GPL-2.0+
 *
 * (C) Copyright 2023 Rockchip Electronics Co., Ltd
 */

/dts-v1/;
#include "rk3506.dtsi"
#include "rk3506-u-boot.dtsi"
#include <dt-bindings/input/input.h>

/ {
	model = "Rockchip RK3506 EVB Board";
	compatible = "rockchip,rk3506-evb", "rockchip,rk3506";

	adc-keys {
		compatible = "adc-keys";
		io-channels = <&saradc 1>;
		io-channel-names = "buttons";
		keyup-threshold-microvolt = <1800000>;
		u-boot,dm-spl;
		status = "okay";

		volumeup-key {
			u-boot,dm-spl;
			linux,code = <KEY_VOLUMEUP>;
			label = "volume up";
			press-threshold-microvolt = <1750>;
		};
	};
};
