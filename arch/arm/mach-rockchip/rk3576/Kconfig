## arch/arm/mach-rockchip/rk3576/Kconfig
```kconfig
if ROCKCHIP_RK3576

config TARGET_EVB_RK3576
	bool "EVB_RK3576"
	select BOARD_LATE_INIT
	help
	  RK3576 EVB is a evaluation board for Rockchp RK3576.

config TARGET_NANOPI_M5
	bool "FriendlyElec NanoPi M5 Series"
	select BOARD_LATE_INIT
	select VENDOR_FRIENDLYELEC
	help
	  Support for FriendlyElec boards based on RK3576.

config SYS_SOC
	default "rockchip"

config SYS_MALLOC_F_LEN
	default 0x400

source board/rockchip/evb_rk3576/Kconfig
source board/rockchip/nanopi_m5/Kconfig

endif
```

## board/rockchip/nanopi_m5/Kconfig
```kconfig
if TARGET_NANOPI_M5

config SYS_BOARD
	default "nanopi_m5"

config SYS_VENDOR
	default "rockchip"

config SYS_CONFIG_NAME
	default "nanopi_m5"

config BOARD_SPECIFIC_OPTIONS
	def_bool y

endif
```
