## arch/arm/mach-rockchip/rk3328/Kconfig
```kconfig
if ROCKCHIP_RK3328

choice
	prompt "RK3328 board select"

config TARGET_EVB_RK3328
	bool "RK3328 evaluation board"
	select BOARD_LATE_INIT
	help
	  RK3328evb is a evaluation board for Rockchip rk3328,
	  with full function and phisical connectors support like
	  usb2.0 host ports, LVDS, JTAG, MAC, SDcard, HDMI, USB-2-serial...

config TARGET_NANOPI_R2
	bool "FriendlyElec NanoPi R2 Series"
	select BOARD_LATE_INIT
	select VENDOR_FRIENDLYELEC
	help
	  Support for FriendlyElec boards based on RK3328.

endchoice

config SYS_SOC
	default "rockchip"

config SYS_MALLOC_F_LEN
	default 0x0800

source "board/rockchip/evb_rk3328/Kconfig"
source "board/rockchip/nanopi_r2/Kconfig"

endif
```

## arch/arm/mach-rockchip/rk3506/Kconfig
```kconfig
if ROCKCHIP_RK3506

config TARGET_EVB_RK3506
	bool "EVB_RK3506"
	select BOARD_LATE_INIT
	help
	  RK3506 EVB is a evaluation board for Rockchip RK3506.

config SYS_SOC
	default "rockchip"

config SYS_MALLOC_F_LEN
	default 0x400

source board/rockchip/evb_rk3506/Kconfig

endif
```

## arch/arm/mach-rockchip/rk3568/Kconfig
```kconfig
if ROCKCHIP_RK3568

config TARGET_EVB_RK3568
	bool "EVB_RK3568"
	select BOARD_LATE_INIT
	help
	  RK3568 EVB is a evaluation board for Rockchp RK3568.

config TARGET_NANOPI5
	bool "FriendlyElec NanoPi 5 Series"
	select BOARD_LATE_INIT
	select VENDOR_FRIENDLYELEC
	help
	  Support for FriendlyElec boards based on RK3568.

config SYS_SOC
	default "rockchip"

config SYS_MALLOC_F_LEN
	default 0x400

source board/rockchip/evb_rk3568/Kconfig
source board/rockchip/nanopi5/Kconfig

endif
```

## arch/arm/mach-rockchip/rk3588/Kconfig
```kconfig
if ROCKCHIP_RK3588

config TARGET_EVB_RK3588
	bool "EVB_RK3588"
	select BOARD_LATE_INIT
	help
	  RK3588 EVB is a evaluation board for Rockchp RK3588.

config TARGET_NANOPI6
	bool "FriendlyElec NanoPi 6 Series"
	select BOARD_LATE_INIT
	select VENDOR_FRIENDLYELEC
	help
	  Support for FriendlyElec boards based on RK3588.

config SYS_SOC
	default "rockchip"

config SYS_MALLOC_F_LEN
	default 0x400

source board/rockchip/evb_rk3588/Kconfig
source board/rockchip/nanopi6/Kconfig

endif
```

## arch/arm/mach-rockchip/rv1103b/Kconfig
```kconfig
if ROCKCHIP_RV1103B

config TARGET_EVB_RV1103B
	bool "EVB_RV1103B"
	select BOARD_LATE_INIT
	help
	  RV1103B EVB is a evaluation board for Rockchip RV1103B.

config SYS_SOC
	default "rockchip"

config SYS_MALLOC_F_LEN
	default 0x400

source board/rockchip/evb_rv1103b/Kconfig

endif
```

## board/rockchip/nanopi4/Kconfig
```kconfig
if TARGET_NANOPI4

config SYS_BOARD
	default "nanopi4"

config SYS_VENDOR
	default "rockchip"

config SYS_CONFIG_NAME
	default "nanopi4"

config BOARD_SPECIFIC_OPTIONS
	def_bool y

endif
```

## board/rockchip/nanopi5/Kconfig
```kconfig
if TARGET_NANOPI5

config SYS_BOARD
	default "nanopi5"

config SYS_VENDOR
	default "rockchip"

config SYS_CONFIG_NAME
	default "nanopi5"

config BOARD_SPECIFIC_OPTIONS
	def_bool y

endif
```

## board/rockchip/rk33xx/Kconfig
```kconfig
if ROCKCHIP_ARCH64

config SYS_BOARD
	default "rk33xx"

config SYS_VENDOR
	default "rockchip"


if PLAT_RK33XX

config SYS_CONFIG_NAME
	default "rk33plat"

config VENDOR_FRIENDLYELEC
	bool "FriendlyELEC rk33xx boards"
	default n

endif

endif
```

## configs/nanopi_r2_defconfig
```kconfig
CONFIG_ARM=y
CONFIG_ARM_CPU_SUSPEND=y
CONFIG_ARCH_ROCKCHIP=y
CONFIG_SPL_LIBCOMMON_SUPPORT=y
CONFIG_SPL_LIBGENERIC_SUPPORT=y
CONFIG_SYS_MALLOC_F_LEN=0x2000
CONFIG_SPL_FIT_GENERATOR="arch/arm/mach-rockchip/make_fit_atf.py"
CONFIG_ROCKCHIP_RK3328=y
CONFIG_ROCKCHIP_VENDOR_PARTITION=y
CONFIG_TPL_LIBCOMMON_SUPPORT=y
CONFIG_TPL_LIBGENERIC_SUPPORT=y
CONFIG_SPL_DRIVERS_MISC_SUPPORT=y
CONFIG_TARGET_NANOPI_R2=y
CONFIG_SPL_STACK_R_ADDR=0x600000
CONFIG_DEFAULT_DEVICE_TREE="rk3328-nanopi-r2"
CONFIG_DEBUG_UART=y
CONFIG_TPL_SYS_MALLOC_F_LEN=0x600
CONFIG_FIT=y
CONFIG_SPL_LOAD_FIT=y
CONFIG_BOOTDELAY=1
CONFIG_SYS_CONSOLE_INFO_QUIET=y
# CONFIG_DISPLAY_CPUINFO is not set
CONFIG_ANDROID_BOOTLOADER=y
# CONFIG_SPL_RAW_IMAGE_SUPPORT is not set
# CONFIG_SPL_LEGACY_IMAGE_SUPPORT is not set
CONFIG_TPL_SYS_MALLOC_SIMPLE=y
CONFIG_SPL_STACK_R=y
CONFIG_SPL_SHA256_SUPPORT=y
CONFIG_SPL_CRYPTO_SUPPORT=y
CONFIG_SPL_HASH_SUPPORT=y
CONFIG_SPL_ATF=y
CONFIG_SPL_ATF_NO_PLATFORM_PARAM=y
CONFIG_TPL_BOOTROM_SUPPORT=y
CONFIG_TPL_DRIVERS_MISC_SUPPORT=y
CONFIG_FASTBOOT_BUF_ADDR=0x800800
CONFIG_FASTBOOT_BUF_SIZE=0x4000000
CONFIG_FASTBOOT_FLASH=y
CONFIG_FASTBOOT_FLASH_MMC_DEV=0
CONFIG_CMD_BOOTZ=y
# CONFIG_CMD_BOOTEFI_HELLO_COMPILE is not set
CONFIG_CMD_DTIMG=y
# CONFIG_CMD_ELF is not set
# CONFIG_CMD_IMI is not set
# CONFIG_CMD_IMLS is not set
# CONFIG_CMD_XIMG is not set
# CONFIG_CMD_LZMADEC is not set
# CONFIG_CMD_FLASH is not set
# CONFIG_CMD_FPGA is not set
CONFIG_CMD_GPT=y
# CONFIG_CMD_LOADB is not set
# CONFIG_CMD_LOADS is not set
CONFIG_CMD_BOOT_ANDROID=y
CONFIG_CMD_BOOT_ROCKCHIP=y
CONFIG_CMD_MMC=y
CONFIG_CMD_USB=y
CONFIG_CMD_USB_MASS_STORAGE=y
# CONFIG_CMD_SETEXPR is not set
CONFIG_CMD_TIME=y
# CONFIG_ISO_PARTITION is not set
CONFIG_EFI_PARTITION_ENTRIES_NUMBERS=64
CONFIG_RKPARM_PARTITION=y
CONFIG_SPL_OF_CONTROL=y
CONFIG_TPL_OF_CONTROL=y
CONFIG_OF_LIVE=y
CONFIG_OF_SPL_REMOVE_PROPS="pinctrl-0 pinctrl-names interrupt-parent assigned-clocks assigned-clock-rates assigned-clock-parents"
# CONFIG_NET_TFTP_VARS is not set
CONFIG_TPL_DM=y
CONFIG_REGMAP=y
CONFIG_SPL_REGMAP=y
CONFIG_TPL_REGMAP=y
CONFIG_SYSCON=y
CONFIG_SPL_SYSCON=y
CONFIG_TPL_SYSCON=y
CONFIG_CLK=y
CONFIG_SPL_CLK=y
CONFIG_TPL_CLK=y
CONFIG_DM_CRYPTO=y
CONFIG_ROCKCHIP_CRYPTO_V1=y
CONFIG_ROCKCHIP_GPIO=y
CONFIG_SYS_I2C_ROCKCHIP=y
CONFIG_DM_KEY=y
CONFIG_MISC=y
CONFIG_ROCKCHIP_EFUSE=y
CONFIG_MMC_DW=y
CONFIG_MMC_DW_ROCKCHIP=y
CONFIG_SPI_FLASH=y
CONFIG_DM_ETH=y
CONFIG_ETH_DESIGNWARE=y
CONFIG_GMAC_ROCKCHIP=y
CONFIG_PHY_ROCKCHIP_INNO_USB2=y
CONFIG_PINCTRL=y
CONFIG_SPL_PINCTRL=y
CONFIG_DM_PMIC=y
CONFIG_PMIC_RK8XX=y
CONFIG_REGULATOR_PWM=y
CONFIG_DM_REGULATOR_FIXED=y
CONFIG_REGULATOR_RK8XX=y
CONFIG_PWM_ROCKCHIP=y
CONFIG_RAM=y
CONFIG_SPL_RAM=y
CONFIG_TPL_RAM=y
CONFIG_ROCKCHIP_SDRAM_COMMON=y
CONFIG_DM_RESET=y
CONFIG_BAUDRATE=1500000
CONFIG_DEBUG_UART_BASE=0xFF130000
CONFIG_DEBUG_UART_CLOCK=24000000
CONFIG_DEBUG_UART_SHIFT=2
CONFIG_SYSRESET=y
CONFIG_USB=y
CONFIG_USB_XHCI_HCD=y
CONFIG_USB_XHCI_DWC3=y
CONFIG_USB_EHCI_HCD=y
CONFIG_USB_EHCI_GENERIC=y
CONFIG_USB_OHCI_HCD=y
CONFIG_USB_OHCI_GENERIC=y
CONFIG_USB_DWC2=y
CONFIG_USB_DWC3=y
CONFIG_USB_DWC3_GENERIC=y
CONFIG_USB_STORAGE=y
CONFIG_USB_GADGET=y
CONFIG_USB_GADGET_MANUFACTURER="Rockchip"
CONFIG_USB_GADGET_VENDOR_NUM=0x2207
CONFIG_USB_GADGET_PRODUCT_NUM=0x330a
CONFIG_USB_GADGET_DWC2_OTG=y
CONFIG_USB_GADGET_DOWNLOAD=y
CONFIG_DM_VIDEO=y
CONFIG_DISPLAY=y
CONFIG_DRM_ROCKCHIP=y
CONFIG_DRM_ROCKCHIP_PANEL=y
CONFIG_DRM_ROCKCHIP_DW_HDMI=y
CONFIG_LCD=y
CONFIG_USE_TINY_PRINTF=y
CONFIG_LIB_RAND=y
CONFIG_SPL_TINY_MEMSET=y
CONFIG_TPL_TINY_MEMSET=y
CONFIG_ERRNO_STR=y
CONFIG_AVB_LIBAVB=y
CONFIG_AVB_LIBAVB_AB=y
CONFIG_AVB_LIBAVB_ATX=y
CONFIG_AVB_LIBAVB_USER=y
CONFIG_RK_AVB_LIBAVB_USER=y
CONFIG_OPTEE_CLIENT=y
CONFIG_OPTEE_V1=y
CONFIG_OPTEE_ALWAYS_USE_SECURITY_PARTITION=y
CONFIG_TEST_ROCKCHIP=y
```
